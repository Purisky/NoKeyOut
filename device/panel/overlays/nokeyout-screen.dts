/dts-v1/;
/plugin/;

/ {
	compatible = "friendlyelec,nanopi-neo3-plus", "rockchip,rk3528";

	fragment@0 {
		target = <&spi1>;
		__overlay__ {
			status = "okay";
			num-cs = <2>;
			pinctrl-names = "default";
			pinctrl-0 = <&spi1_csn0 &spi1_csn1 &spi1_pins>;

			spidev@1 {
				compatible = "armbian,spi-dev";
				reg = <1>;
				spi-max-frequency = <10000000>;
				status = "okay";
			};
		};
	};
};
